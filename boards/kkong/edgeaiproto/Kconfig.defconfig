## boards/kkong/edgeaiproto/Kconfig.defconfig
```kconfig
# B_U585I_IOT02A discovery kit board configuration

# Copyright (c) 2021 STMicroelectronics
# SPDX-License-Identifier: Apache-2.0

if BOARD_EDGEAIPROTO

config BOARD
    default "edgeaiproto"

endif # BOARD_EDGEAIPROTO
```

## boards/kkong/edgeaiproto/Kconfig.edgeaiproto
```kconfig
# Copyright (c) 2021 STMicroelectronics
# SPDX-License-Identifier: Apache-2.0

config BOARD_EDGEAIPROTO
    select SOC_STM32U585XX
    
```

## boards/kkong/edgeaiproto/board.yml
```yaml
board:
  name: edgeaiproto
  vendor: kkong
  socs:
    - name: stm32u585xx
      variants:
        - name: ns
```

## boards/kkong/edgeaiproto/edgeaiproto_defconfig
```kconfig
# SPDX-License-Identifier: Apache-2.0

# Clock configuration
CONFIG_CLOCK_CONTROL=y

# Enable ARM MPU
CONFIG_ARM_MPU=y

# Console/Debug UART
CONFIG_SERIAL=y
CONFIG_CONSOLE=y
CONFIG_UART_CONSOLE=y

# GPIO
CONFIG_GPIO=y

# Enable TrustZone if using secure firmware
# CONFIG_TRUSTED_EXECUTION_NONSECURE=y
```

## modules/stm32u5_dcmi/dts/bindings/video/st,stm32u5-dcmi.yaml
```yaml
# Binding for out-of-tree STM32 DCMI driver (STM32U5 GPDMA).
# Same schema as st,stm32-dcmi; use this compatible so the in-tree driver
# does not bind and this module's driver is used instead.
description: |
  STM32 DCMI for U5 (GPDMA). Same as st,stm32-dcmi but for the out-of-tree
  driver that uses GPDMA (DMA_NORMAL, etc.).

compatible: "st,stm32u5-dcmi"

include: [base.yaml, pinctrl-device.yaml]

properties:
  interrupts:
    required: true
  dmas:
    required: true
    description: |
      phandle of DMA controller (e.g. GPDMA1 for STM32U5).
  clocks:
    required: true
  reg:
    required: true

child-binding:
  child-binding:
    include: video-interfaces.yaml
```

## modules/stm32u5_dcmi/zephyr/Kconfig
```kconfig
# STM32U5 DCMI (GPDMA) out-of-tree driver
# Use with compatible "st,stm32u5-dcmi" and CONFIG_VIDEO_STM32_DCMI=n for the board.

config VIDEO_STM32U5_DCMI
	bool "STM32U5 DCMI driver (GPDMA)"
	default y
	depends on DT_HAS_ST_STM32U5_DCMI_ENABLED
	select PINCTRL
	select USE_STM32_HAL_DCMI
	select DMA
	select USE_STM32_HAL_DMA
	select USE_STM32_HAL_DMA_EX
	help
	  Out-of-tree DCMI driver for STM32U5 with GPDMA support.
	  Requires board to use compatible "st,stm32u5-dcmi" and
	  CONFIG_VIDEO_STM32_DCMI=n.
```
